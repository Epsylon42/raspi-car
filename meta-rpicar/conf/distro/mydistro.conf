## meta-rpicar/conf/distro/mydistro.conf
```bitbake
require conf/distro/poky.conf

DISTRO = "mydistro"
DISTRO_NAME = "mydistro"
DISTRO_VERSION = "1.0"

DISTRO_FEATURES = " \
    acl \
    ext2 vfat \
    gobject-introspection-data \
    ipv4 ipv6 \
    ldconfig \
    seccomp \
    systemd \
    usrmerge \
    wifi \
    xattr \
"
DISTRO_FEATURES_BACKFILL_CONSIDERED = "pulseaudio"

INIT_MANAGER = "systemd"
NETWORK_MANAGER = "networkmanager"
PACKAGECONFIG:pn-networkmanager = "systemd wifi nss nmcli readline"

RPI_USE_U_BOOT = "1"
ENABLE_UART = "1"
PREFERRED_PROVIDER_u-boot-fw-utils = "libubootenv"

IMAGE_INSTALL:append = " \
    networkmanager \
    wireless-regdb-static \
    linux-firmware-rpidistro-bcm43430 \
    kernel-modules \
 \
    ssh-auth \
    balena-wifi-connect \
    test-config \
    tmux \
    htop \
    vim \
"

SYSTEMD_AUTO_ENABLE:pn-dnsmasq = "disable"

# kernel-module-brcmfmac 
# kernel-module-bcm2835-v4l2 

EXTRA_IMAGE_FEATURES:append = " ssh-server-openssh"

INHERIT += "distrooverrides"
DISTRO_FEATURES_OVERRIDES += "rpicar-ota"

IMAGE_FSTYPES = "ext4 ext4.gz wic.gz wic.bmap"
```

## meta-rpicar/conf/distro/rpicar.conf
```bitbake
require conf/distro/poky.conf

cardatadir = "${ROOT_HOME}/car"

DISTRO = "rpicar"
DISTRO_NAME = "rpicar"
DISTRO_VERSION = "1.0"

hostname:pn-base-files = "rpicar"

DISTRO_FEATURES = " \
    acl \
    ext2 vfat \
    gobject-introspection-data \
    ipv4 ipv6 \
    ldconfig \
    seccomp \
    systemd \
    usrmerge \
    wifi \
    xattr \
"
DISTRO_FEATURES_BACKFILL_CONSIDERED = "pulseaudio"

INIT_MANAGER = "systemd"
NETWORK_MANAGER = "networkmanager"
PACKAGECONFIG:pn-networkmanager = "systemd wifi nss nmcli readline"

RPI_USE_U_BOOT = "1"
ENABLE_UART = "1"
VIDEO_CAMERA = "1"
GPU_MEM = "128"
PREFERRED_PROVIDER_u-boot-fw-utils = "libubootenv"

IMAGE_INSTALL:append = " \
    networkmanager \
    wireless-regdb-static \
    linux-firmware-rpidistro-bcm43430 \
    kernel-modules \
 \
    ssh-auth \
    balena-wifi-connect \
    test-config \
    tmux \
    htop \
    vim \
\
    gpiosrv \
    rpicar-caddy \
    rpicar-mediamtx \
\
    mediamtx \
    v4l-utils \
    gstreamer1.0 \
    gstreamer1.0-plugins-base \
    gstreamer1.0-plugins-good \
    gstreamer1.0-plugins-bad \
    gstreamer1.0-plugins-ugly \
    gstreamer1.0-rtsp-server \
"
PACKAGECONFIG:pn-x264 = ""
PACKAGECONFIG:pn-gstreamer1.0-plugins-base = ""
PACKAGECONFIG:pn-gstreamer1.0-plugins-good = "libv4l2 v4l2 soup3"
PACKAGECONFIG:pn-gstreamer1.0-plugins-bad = "openh264"
PACKAGECONFIG:pn-gstreamer1.0-plugins-ugly = "x264"
SKIP_RECIPE[ffmpeg] = "not necessary"

SYSTEMD_AUTO_ENABLE:pn-dnsmasq = "disable"

EXTRA_IMAGE_FEATURES:append = " ssh-server-openssh"

INHERIT += "distrooverrides"
DISTRO_FEATURES_OVERRIDES += "rpicar-ota"

IMAGE_FSTYPES = "ext4 ext4.gz wic.gz wic.bmap"
```

## meta-rpicar/files/wic/sd-card-layout-default.wks
```
part /boot --size 100M --source bootimg-partition --ondisk mmcblk0 --fstype=vfat --label boot --active --align 4096
part / --size 200M --source rootfs --ondisk mmcblk0 --fstype=ext4 --label root --align 4096
```

## meta-rpicar/wic/sd-card-layout-ab.wks
```
part /boot --size 100M --source bootimg-partition --ondisk mmcblk0 --fstype=vfat --label boot --active --align 4096
part / --size 400M --source rootfs --ondisk mmcblk0 --fstype=ext4 --label root --align 4096
part --size 400M --source rootfs --ondisk mmcblk0 --fstype=ext4 --label root2 --align 4096
part /persistent --source rootfs --change-directory=persistent --size 50M --ondisk mmcblk0 --fstype=ext4 --label data --align 4096
```
